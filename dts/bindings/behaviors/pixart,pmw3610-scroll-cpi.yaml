## dts/bindings/behaviors/pixart,pmw3610-scroll-cpi.yaml
```yaml
# Copyright (c) 2024 The ZMK Contributors
# SPDX-License-Identifier: MIT

description: |
  Behavior to change the PMW3610 SCROLL-mode CPI at runtime.
  param1 is the target CPI (200..3200, multiple of 200).
  The trackball is resolved automatically (DEVICE_DT_GET_ONE), so no device
  phandle is needed; this lets the node live in a shared dtsi across a split.

compatible: "pixart,pmw3610-scroll-cpi"

include: one_param.yaml
```
